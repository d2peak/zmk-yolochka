## config/boards/shields/yolochka/Kconfig.defconfig
```kconfig
# Copyright (c) 2020 The ZMK Contributors
# SPDX-License-Identifier: MIT

if SHIELD_YOLOCHKA

config ZMK_KEYBOARD_NAME
	default "YOLOCHKA"


endif
```

## config/west.yml
```yaml
manifest:
  remotes:
    - name: zmkfirmware
      url-base: https://github.com/zmkfirmware
    - name: sqdbruh
      url-base: https://github.com/sqdbruh
  projects:
    - name: zmk_led
      remote: aroum
      revision: main
      import: app/west.yml
  self:
    path: config
```
